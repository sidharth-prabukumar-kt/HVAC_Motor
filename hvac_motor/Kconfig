## hvac_motor/modules/boards/arm/hvac_motor_stm32f3/Kconfig.board
```kconfig
# HVAC Motor Controller board configuration

# Copyright (c) 2017 I-SENSE group of ICCS
# SPDX-License-Identifier: Apache-2.0

config BOARD_HVAC_MOTOR_STM32F3
	bool "HVAC Motor Controller Board"
	depends on SOC_STM32F302X8
```

## hvac_motor/modules/boards/arm/hvac_motor_stm32f3/Kconfig.defconfig
```kconfig
# HVAC Motor Controller board configuration

# Copyright (c) 2017 I-SENSE group of ICCS
# SPDX-License-Identifier: Apache-2.0

if BOARD_HVAC_MOTOR_STM32F3

config BOARD
	default "hvac_motor_stm32f3"

endif # BOARD_HVAC_MOTOR_STM32F3
```
